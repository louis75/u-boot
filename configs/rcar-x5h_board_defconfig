## configs/rcar-x5h_board_defconfig
```kconfig
CONFIG_ARM=y
CONFIG_ARCH_CPU_INIT=y
CONFIG_ARCH_RMOBILE=y
CONFIG_SYS_TEXT_BASE=0x50000000
CONFIG_SYS_MALLOC_LEN=0x4000000
CONFIG_DM_GPIO=y
CONFIG_DM_ETH=y
CONFIG_RENESAS_ETHER_SWITCH3=y
CONFIG_RENESAS_ETHER_SWITCH3_DEFAULT_PORT=0
CONFIG_PHY_MARVELL=y
CONFIG_DM_REGULATOR=y
CONFIG_DM_REGULATOR_FIXED=y
CONFIG_DEFAULT_DEVICE_TREE="rcar-x5h-board-u-boot"
CONFIG_RCAR_GEN5=y
CONFIG_TARGET_RCAR_X5H_BOARD=y
# CONFIG_PSCI_RESET is not set
CONFIG_SYS_LOAD_ADDR=0x58000000
CONFIG_FIT=y
CONFIG_SUPPORT_RAW_INITRD=y
CONFIG_USE_BOOTARGS=y
CONFIG_BOOTARGS="console=ttyAMA0,38400n8 cma=560M root=/dev/vda ip=10.10.10.20"
CONFIG_HUSH_PARSER=y
CONFIG_CMD_BOOTZ=y
CONFIG_CMD_GPIO=y
CONFIG_CMD_DHCP=y
CONFIG_CMD_MII=y
CONFIG_CMD_PING=y
CONFIG_CMD_EXT2=y
CONFIG_CMD_EXT4=y
CONFIG_CMD_EXT4_WRITE=y
CONFIG_CMD_FAT=y
CONFIG_CMD_FS_GENERIC=y
CONFIG_SYS_RELOC_GD_ENV_ADDR=y
CONFIG_OF_CONTROL=y
CONFIG_ENV_IS_NOWHERE=y
CONFIG_VERSION_VARIABLE=y
CONFIG_REGMAP=y
CONFIG_SYSCON=y
CONFIG_CLK=y
CONFIG_BAUDRATE=921600
CONFIG_PL01X_SERIAL=y
CONFIG_SCIF_CONSOLE=y
CONFIG_NET_RANDOM_ETHADDR=y
CONFIG_PHY_FIXED=y
CONFIG_ENV_OVERWRITE=y
```
